
define symbol __region_RAM_start__			= 0x30780000;			// 内存开始地址 RAM的中间地址
define symbol __region_RAM_end__			= 0x007fffff;			// 内存总大小	K21D=32K,K21F=64K	
//define symbol __ICFEDIT_size_cstack__		= 0x00002000;			// 栈空间总大小	8K	

define memory mem with size = 4G;
define region RAM_region = mem:[from __region_RAM_start__			to	__region_RAM_end__			];


initialize by copy 						{ readwrite };
//do not initialize  					{ section .noinit };
place at address mem:__region_RAM_start__ 	{ readonly section .code_entry };
place in RAM_region   					{ readonly };
place in RAM_region   					{readwrite};
